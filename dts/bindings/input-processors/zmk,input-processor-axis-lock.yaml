## dts/bindings/input-processors/zmk,input-processor-axis-lock.yaml
```yaml
# Copyright (c) 2024 The ZMK Contributors
# SPDX-License-Identifier: MIT

description: Axis Lock Input Processor

compatible: "zmk,input-processor-axis-lock"

properties:
  "#input-processor-cells":
    type: int
    const: 0
    description: "Number of cells in input processor specifier"

  lock-threshold:
    type: int
    default: 24
    description: "Minimum combined movement before locking to X or Y axis"

  dominance-ratio-percent:
    type: int
    default: 140
    description: "Required dominance ratio to lock an axis. 140 means 1.4x stronger than the other axis"

  idle-timeout-ms:
    type: int
    default: 80
    description: "Reset axis lock after this many milliseconds without movement"
```

## dts/bindings/input-processors/zmk,input-processor-mouse-gesture.yaml
```yaml
# Copyright (c) 2024 The ZMK Contributors
# SPDX-License-Identifier: MIT

description: Mouse Gesture Input Processor

compatible: "zmk,input-processor-mouse-gesture"

properties:
  "#input-processor-cells":
    type: int
    const: 0
    description: "Number of cells in input processor specifier"

  track-remainders:
    type: boolean
    description: "Whether to track remainders"

  stroke-size:
    type: int
    default: 200
    description: "Size of one stroke in a gesture. Note that larger stroke than this value is fine, as duplicate directions will be ignored."

  movement-threshold:
    type: int
    default: 10
    description: "Threshold for each x/y event"

  enable-eager-mode:
    type: boolean
    description: "Execute pattern matching in real-time and invoke bindings immediately when gesture pattern is matched. (Duplicate gestures are resolved by invoking after idle timeout, which will be canceled if longer gesture is detected within the timeout, while non-duplicate gestures are invoked immediately.) When disabled, pattern match will only be performed when idle timeout triggers or the activation key is released."

  idle-timeout-ms:
    type: int
    default: 150
    description: "Time in milliseconds to wait for idle before invoking gesture. When set to 0, idle timeout is disabled."

  gesture-cooldown-ms:
    type: int
    default: 500
    description: "Time in milliseconds to stop processing for next gesture after the execution of a gesture. This is useful to prevent unexpected double gestures."

  mac-layer:
    type: int
    default: -1
    description: "Layer number that selects Mac-specific bindings. When negative, Mac-specific switching is disabled."

child-binding:
  description: "Mouse gesture definition"
  properties:
    pattern:
      type: array
      required: true
      description: "Array of gesture directions that make up this gesture sequence"

    bindings:
      type: phandle-array
      description: "Default/fallback behaviors to be invoked when this gesture is detected. Used as Win bindings when win-bindings is omitted."

    win-bindings:
      type: phandle-array
      specifier-space: binding
      description: "Behaviors to be invoked when this gesture is detected while Mac layer is not active"

    mac-bindings:
      type: phandle-array
      specifier-space: binding
      description: "Behaviors to be invoked when this gesture is detected while Mac layer is active"

    wait-ms:
      type: int
      description: "Time in milliseconds to wait between consecutive behavior invocations in the gesture sequence"

    tap-ms:
      type: int
      description: "Time in milliseconds between press and release events for each behavior in the gesture sequence"
```
